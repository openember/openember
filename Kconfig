## Kconfig
```kconfig
mainmenu "OpenEmber Configuration"

menu "Build / Toolchain"

config OPENEMBER_CROSSCOMPILE_ENABLED
    bool "Enable cross compile mode (aarch64)"
    default n

config OPENEMBER_DEBUG_ENABLED
    bool "Debug build"
    default y

config OPENEMBER_OPTIMIZATION_DISABLED
    bool "Disable optimization"
    default n

config OPENEMBER_ENABLE_OPENMP
    bool "Enable OpenMP"
    default n

choice OPENEMBER_THIRD_PARTY_MODE_CHOICE
    prompt "Third-party mode"
    default OPENEMBER_TP_MODE_FETCH

config OPENEMBER_TP_MODE_FETCH
    bool "FetchContent"

config OPENEMBER_TP_MODE_VENDOR
    bool "Vendor (third_party/ archives + optional PAHO_MQTT_C_LOCAL_SOURCE, see docs)"

config OPENEMBER_TP_MODE_SYSTEM
    bool "System packages"

endchoice

endmenu

menu "Application Layer"

source "apps/Kconfig"
source "system/Kconfig"
source "services/Kconfig"
source "examples/Kconfig"
source "tools/Kconfig"

endmenu

menu "Middleware"

source "communication/Kconfig"
source "core/Kconfig"

endmenu

source "components/Kconfig"
source "platform/Kconfig"
source "third_party/Kconfig"
source "test/Kconfig"
```

## apps/Kconfig
```kconfig
menu "Product Applications"

config OPENEMBER_APP_SMART_DEVICE_DEMO
    bool "Build product app: smart_device_demo"
    default y
    depends on OPENEMBER_ENABLE_LINK
    depends on OPENEMBER_ENABLE_MSGS
    help
      Build a small product-application entry point that initializes OpenEmber
      Link, creates a product node, and publishes openember-msgs NodeHeartbeat
      messages. Use it as a starting point for project-specific apps under
      apps/.

config OPENEMBER_APP_TURTLE_DEMO
    bool "Build product app: turtle_demo (host sim + teleop)"
    default y
    depends on OPENEMBER_ENABLE_LINK
    depends on OPENEMBER_ENABLE_MSGS
    help
      Build a turtlesim-style host demo: openember_turtle_sim integrates
      Twist2D commands into Pose2D and opens an SDL2 window on Linux
      (install libsdl2-dev; use --no-gui for headless). teleop publishes
      keyboard or --demo motion. See configs/turtle.launch.yaml.

config OPENEMBER_APP_ROVER_DEMO
    bool "Build product app: rover_demo (diff-drive host sim)"
    default y
    depends on OPENEMBER_ENABLE_LINK
    depends on OPENEMBER_ENABLE_MSGS
    help
      Build openember_rover_sim / openember_rover_teleop: differential-drive
      kinematics with cmd timeout and /rover/estop safety. See
      configs/rover.launch.yaml and docs/design/rover-demo.md.

config OPENEMBER_APP_AGRI_STATION_DEMO
    bool "Build product app: agri_station_demo (smart agri mock)"
    default y
    depends on OPENEMBER_ENABLE_LINK
    depends on OPENEMBER_ENABLE_MSGS
    help
      Build openember_agri_mock_sensors / openember_agri_station_app: mock
      climate and soil publishers plus a product app with thresholds and
      degrade. See configs/agri_station.launch.yaml and
      docs/design/agri-station-demo.md.

config OPENEMBER_AGRI_STATION_GUI
    bool "Agri station app: Qt field console UI"
    default y
    depends on OPENEMBER_APP_AGRI_STATION_DEMO
    help
      Link agri_station_app against system Qt6/Qt5 Widgets+Charts for an
      on-device field console with nav bar and chart cards (not web). Install
      qt6-base-dev and qt6-charts-dev (or Qt5 equivalents). Use --no-gui /
      --headless when no display is available. Qt is NOT fetched into
      third_party/.

endmenu
```

## communication/Kconfig
```kconfig
menu "Communication"

menu "Link"

config OPENEMBER_ENABLE_LINK
    bool "Enable OpenEmber Link"
    default y
    depends on OPENEMBER_COMPONENT_TRANSPORT
    help
      Build the stable OpenEmber communication layer for Topic, Service,
      Liveliness, node discovery, diagnostics, and message serialization.

endmenu

menu "Messages"

config OPENEMBER_ENABLE_MSGS
    bool "Enable openember-msgs protocol bindings"
    default y
    help
      Build generated protocol bindings from openember-msgs for OpenEmber
      runtime nodes, tools, diagnostics, parameters, and device management.

choice OPENEMBER_MSGS_SOURCE_CHOICE
    prompt "openember-msgs source"
    depends on OPENEMBER_ENABLE_MSGS
    default OPENEMBER_MSGS_SOURCE_FETCH

config OPENEMBER_MSGS_SOURCE_FETCH
    bool "FETCH"
    help
      Download the selected openember-msgs ref during CMake configure.

config OPENEMBER_MSGS_SOURCE_LOCAL
    bool "LOCAL"
    help
      Use a local openember-msgs checkout. OPENEMBER_MSGS_LOCAL_SOURCE must be
      an absolute path.

endchoice

config OPENEMBER_MSGS_LOCAL_SOURCE
    string "openember-msgs local source path"
    depends on OPENEMBER_ENABLE_MSGS && OPENEMBER_MSGS_SOURCE_LOCAL
    default ""
    help
      Absolute path to an openember-msgs checkout. The path must contain
      CMakeLists.txt.

choice OPENEMBER_MSGS_REF_CHOICE
    prompt "openember-msgs version"
    depends on OPENEMBER_ENABLE_MSGS && OPENEMBER_MSGS_SOURCE_FETCH
    default OPENEMBER_MSGS_REF_LATEST

config OPENEMBER_MSGS_REF_LATEST
    bool "latest"

endchoice

endmenu

endmenu
```

## core/Kconfig
```kconfig
menu "Core Runtime"

comment "Framework library (openember::core). Enabled by OpenEmber Link."

config OPENEMBER_ENABLE_CORE
    bool
    default y if OPENEMBER_ENABLE_LINK
    depends on OPENEMBER_ENABLE_LINK

endmenu
```

## examples/references/Kconfig
```kconfig
config OPENEMBER_REFERENCE_SENSOR_DATA
    bool "Build reference example: sensor_data_reference"
    default y
```

## modules/Kconfig
```kconfig
menu "Module"

comment "Framework modules use OpenEmber Link (Zenoh) via components/transport."

endmenu
```

## services/Kconfig
```kconfig
menu "Services"

config OPENEMBER_SERVICE_HARDWARE_INTERFACE
    bool "Build service: hardware_interface"
    default y
    depends on OPENEMBER_ENABLE_LINK
    depends on OPENEMBER_ENABLE_MSGS
    depends on OPENEMBER_COMPONENT_SENSOR
    depends on OPENEMBER_USE_YAMLCPP
    help
      Build the OpenEmber Hardware Interface runtime service. The V1 service
      manages configured sensor endpoints and publishes samples, heartbeat,
      devices, and diagnostics through OpenEmber Link. The service can load
      its endpoint topology from a local YAML file.

if OPENEMBER_SERVICE_HARDWARE_INTERFACE

menu "Hardware Interface Endpoints"

config OPENEMBER_HARDWARE_ENDPOINT_IMU
    bool "IMU"
    default y
    depends on OPENEMBER_COMPONENT_SENSOR

config OPENEMBER_HARDWARE_ENDPOINT_TEMPERATURE
    bool "Temperature"
    default y
    depends on OPENEMBER_COMPONENT_SENSOR

config OPENEMBER_HARDWARE_ENDPOINT_GNSS
    bool "GNSS"
    default y
    depends on OPENEMBER_COMPONENT_SENSOR

config OPENEMBER_HARDWARE_ENDPOINT_JOINT_CONTROLLER
    bool "Joint Controller"
    default n
    depends on OPENEMBER_COMPONENT_ACTUATOR
    help
      Build the first actuator endpoint for JointController command/state
      loop testing. V1 uses MockJointController and is disabled by default
      until a product explicitly opts into actuator endpoint validation.

endmenu

endif

config OPENEMBER_SERVICE_OTA_AGENT
    bool "Build service: ota_agent"
    default y

config OPENEMBER_SERVICE_WEB_CONSOLE
    bool "Build service: web_console"
    default y

config OPENEMBER_WEB_CONSOLE_ROOT_DIR
    string "web_console web root directory"
    default "services/web_console/web_root"
    depends on OPENEMBER_SERVICE_WEB_CONSOLE
    help
      Default web root directory for web_console.
      If a relative path is used, CMake will treat it as relative to the repository root.

config OPENEMBER_WEB_CONSOLE_PORT
    int "web_console HTTP port"
    default 8000
    range 1 65535
    depends on OPENEMBER_SERVICE_WEB_CONSOLE
    help
      HTTP listen port for web_console. Server binds to 0.0.0.0:<port>.

config OPENEMBER_SERVICE_LOGGER
    bool "Build service: logger"
    default y

config OPENEMBER_LOGGER_PORT
    int "logger HTTP port (local)"
    default 18081
    range 1 65535
    depends on OPENEMBER_SERVICE_LOGGER
    help
      Local listen port for logger service, typically bound to 127.0.0.1.

config OPENEMBER_LOGGER_LOG_DIR
    string "logger source log directory"
    default "/var/log/openember"
    depends on OPENEMBER_SERVICE_LOGGER
    help
      Directory where logger scans *.log files generated by process log sinks.

endmenu
```

## system/Kconfig
```kconfig
menu "System Nodes"

config OPENEMBER_SYSTEM_LAUNCH_MANAGER
    bool "Build system node: launch_manager"
    default y
    depends on OPENEMBER_ENABLE_LINK
    depends on OPENEMBER_USE_YAMLCPP
    help
      Build the OpenEmber runtime supervisor. launch_manager starts the local
      Link router, reads a launch YAML file, starts configured child processes,
      and supervises their process lifecycle.

config OPENEMBER_SYSTEM_LOG_SERVICE
    bool "Build system node: log_service"
    default y

config OPENEMBER_SYSTEM_DEVICE_MANAGER
    bool "Build system node: device_manager"
    default y

config OPENEMBER_SYSTEM_CONFIG_SERVICE
    bool "Build system node: config_service"
    default y

config OPENEMBER_SYSTEM_HEALTH_MONITOR
    bool "Build system node: health_monitor"
    default y

endmenu
```

## test/Kconfig
```kconfig
menu "Tests"

config OPENEMBER_ENABLE_TESTS
    bool "Build and register tests (test/)"
    default n
    help
      When enabled, CMake sets TESTS_ENABLED and builds executables under test/,
      registers them with CTest (ctest / make test).
      Native Linux builds also register process integration tests when their
      service and example targets are enabled. These tests require Python 3.
      Disable for production or embedded images where tests are not needed.

endmenu
```
