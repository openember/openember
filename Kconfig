## services/hardware_interface/Kconfig
```kconfig
config OPENEMBER_SERVICE_HARDWARE_INTERFACE
    bool "Build service: hardware_interface"
    default y
    depends on OPENEMBER_ENABLE_LINK
    depends on OPENEMBER_ENABLE_MSGS
    depends on OPENEMBER_COMPONENT_SENSOR
    depends on OPENEMBER_USE_YAMLCPP
    help
      Build the OpenEmber Hardware Interface runtime service. The V1 service
      manages configured sensor endpoints and publishes samples, heartbeat,
      devices, and diagnostics through OpenEmber Link. The service can load
      its endpoint topology from a local YAML file.

if OPENEMBER_SERVICE_HARDWARE_INTERFACE

menu "Hardware Interface Endpoints"

config OPENEMBER_HARDWARE_ENDPOINT_IMU
    bool "IMU"
    default y
    depends on OPENEMBER_COMPONENT_SENSOR

config OPENEMBER_HARDWARE_ENDPOINT_TEMPERATURE
    bool "Temperature"
    default y
    depends on OPENEMBER_COMPONENT_SENSOR

config OPENEMBER_HARDWARE_ENDPOINT_GNSS
    bool "GNSS"
    default y
    depends on OPENEMBER_COMPONENT_SENSOR

config OPENEMBER_HARDWARE_ENDPOINT_JOINT_CONTROLLER
    bool "Joint Controller"
    default n
    depends on OPENEMBER_COMPONENT_ACTUATOR
    help
      Build the first actuator endpoint for JointController command/state
      loop testing. V1 uses MockJointController and is disabled by default
      until a product explicitly opts into actuator endpoint validation.

endmenu

endif
```

## templates/device/products/default/product.defconfig
```kconfig
# Model: __MODEL__
CONFIG_OPENEMBER_ENABLE_LINK=y
CONFIG_OPENEMBER_ENABLE_MSGS=y
CONFIG_OPENEMBER_APP_TURTLE_DEMO=n
CONFIG_OPENEMBER_APP_SMART_DEVICE_DEMO=n
CONFIG_PRODUCT_MODEL="__MODEL__"
CONFIG_PRODUCT_BUILD_APP=y
```

## tools/Kconfig
```kconfig
menu "Tools"

config OPENEMBER_ENABLE_TOOLS_GAMEPAD_MONITOR
    bool "Build F710 XInput monitor"
    depends on OPENEMBER_ENABLE_TOOLS && OPENEMBER_COMPONENT_REMOTE_CONTROL
    default y
    help
      Read-only Linux evdev monitor. No actuator or transport dependency.

config OPENEMBER_ENABLE_TOOLS
    bool "Build OpenEmber utilities (tools/)"
    default y
    help
      Host-side command-line utilities shipped with OpenEmber.
      Individual tools may require platform libraries (e.g. LPIO).

config OPENEMBER_ENABLE_TOOLS_EMCOM
    bool "Build emcom (picocom-like serial console)"
    depends on OPENEMBER_ENABLE_TOOLS
    depends on OPENEMBER_ENABLE_LPIO
    default y
    help
      Interactive serial terminal using LPIO SerialPort.
      Installed as executable emcom. Requires OPENEMBER_ENABLE_LPIO.

config OPENEMBER_ENABLE_TOOLS_SBUS_RECEIVER
    bool "Build sbus-receiver (SBUS channel monitor)"
    depends on OPENEMBER_ENABLE_TOOLS
    depends on OPENEMBER_ENABLE_LPIO
    default y
    help
      Receive Futaba SBUS frames and print PWM / switch channels.
      Installed as executable sbus-receiver. Requires OPENEMBER_ENABLE_LPIO.

endmenu
```
