## platform/Kconfig
```kconfig
menu "Platform"

menu "OSAL"

config OPENEMBER_ENABLE_OSAL
    bool "Build OSAL (Thread / Mutex / Timer ...)"
    default y
    help
      Platform OSAL for Linux: mutex, thread join, sleep, monotonic clock.
      Produces static library openember_osal.

endmenu

config OPENEMBER_ENABLE_LPIO
    bool "Build LPIO (Linux Peripheral I/O, C++ RAII)"
    default y
    help
      Modern C++ peripheral I/O: GPIO, UART, I2C, SPI, CAN, PWM, 1-Wire, RS485.
      Produces static library openember_lpio. Independent of other platform layers.

config OPENEMBER_ENABLE_LPIO_EXAMPLES
    bool "Build LPIO examples (serial_echo, i2c_scan, can_logger)"
    depends on OPENEMBER_ENABLE_LPIO
    default n
    help
      Build small demo programs under platform/lpio/examples/.
      Requires OPENEMBER_ENABLE_LPIO.

endmenu
```

## third_party/Kconfig
```kconfig
menu "Third party (bundles)"

comment "Lists all libraries pinned in cmake/Dependencies.cmake."
comment "Required-by-current-config items are forced ON (shown as <*>, cannot turn off)."
comment "Optional ON = pre-fetch only (third_party/ + build/_deps/), no compile/link unless used."
comment "FETCH/VENDOR: OFF = do not download; SYSTEM may ignore bundles (use distro packages)."

config OPENEMBER_THIRD_PARTY_BUNDLE_ZLOG
    bool "Include zlog sources"
    default n
    help
      When log backend is ZLOG, this is forced ON. Otherwise optional: pre-fetch only.

config OPENEMBER_THIRD_PARTY_BUNDLE_SPDLOG
    bool "Include spdlog sources"
    default n
    help
      When log backend is SPDLOG, forced ON. Otherwise optional pre-fetch.

config OPENEMBER_THIRD_PARTY_BUNDLE_CJSON
    bool "Include cJSON sources"
    default n
    help
      When JSON library is cJSON, forced ON. Otherwise optional pre-fetch.

config OPENEMBER_THIRD_PARTY_BUNDLE_NLOHMANN_JSON
    bool "Include nlohmann/json sources"
    default n
    help
      When JSON library is nlohmann/json, forced ON. Otherwise optional pre-fetch.

config OPENEMBER_THIRD_PARTY_BUNDLE_SQLITE
    bool "Include SQLite amalgamation sources"
    default n
    help
      Always required for current OpenEmber build; forced ON.

config OPENEMBER_THIRD_PARTY_BUNDLE_MONGOOSE
    bool "Include Mongoose sources"
    default n
    help
      Always required for current OpenEmber build; forced ON.

config OPENEMBER_THIRD_PARTY_BUNDLE_YAMLCPP
    bool "Include yaml-cpp sources"
    default n
    help
      When yaml-cpp is enabled, forced ON. Otherwise optional pre-fetch.

config OPENEMBER_THIRD_PARTY_BUNDLE_ASIO
    bool "Include standalone Asio sources"
    default n
    help
      When Asio is enabled, forced ON. Otherwise optional pre-fetch.

config OPENEMBER_THIRD_PARTY_BUNDLE_PAHO
    bool "Include Eclipse Paho MQTT C sources"
    default n
    help
      When MQTT component is enabled, forced ON. Otherwise optional pre-fetch.

config OPENEMBER_THIRD_PARTY_BUNDLE_NNG
    bool "Include NNG sources"
    default n
    help
      When msgbus backend is NNG, forced ON. Otherwise optional pre-fetch.

config OPENEMBER_THIRD_PARTY_BUNDLE_LCM
    bool "Include LCM sources"
    default n
    help
      When msgbus backend is LCM, forced ON. Otherwise optional pre-fetch.

config OPENEMBER_THIRD_PARTY_BUNDLE_LIBZMQ
    bool "Include libzmq sources"
    default n
    help
      When msgbus backend is ZeroMQ, forced ON (with cppzmq). Otherwise optional pre-fetch.

config OPENEMBER_THIRD_PARTY_BUNDLE_CPPZMQ
    bool "Include cppzmq headers"
    default n
    help
      When msgbus backend is ZeroMQ, forced ON (with libzmq). Otherwise optional pre-fetch.

config OPENEMBER_THIRD_PARTY_BUNDLE_RUCKIG
    bool "Include ruckig sources"
    default n
    help
      When OPENEMBER_USE_RUCKIG, forced ON. Otherwise optional pre-fetch (C++20).

# Hidden linkers: force bundle ON when the matching feature is active (Kconfig select = menu shows <*>).
config OPENEMBER_TP_LINK_ZLOG
    bool
    default y if OPENEMBER_LOG_BACKEND_ZLOG
    select OPENEMBER_THIRD_PARTY_BUNDLE_ZLOG

config OPENEMBER_TP_LINK_SPDLOG
    bool
    default y if OPENEMBER_LOG_BACKEND_SPDLOG
    select OPENEMBER_THIRD_PARTY_BUNDLE_SPDLOG

config OPENEMBER_TP_LINK_CJSON
    bool
    default y if OPENEMBER_JSON_LIBRARY_CJSON
    select OPENEMBER_THIRD_PARTY_BUNDLE_CJSON

config OPENEMBER_TP_LINK_NLOHMANN
    bool
    default y if OPENEMBER_JSON_LIBRARY_NLOHMANN
    select OPENEMBER_THIRD_PARTY_BUNDLE_NLOHMANN_JSON

config OPENEMBER_TP_LINK_SQLITE_MONGOOSE
    bool
    default y
    select OPENEMBER_THIRD_PARTY_BUNDLE_SQLITE
    select OPENEMBER_THIRD_PARTY_BUNDLE_MONGOOSE

config OPENEMBER_TP_LINK_YAMLCPP
    bool
    default y if OPENEMBER_USE_YAMLCPP
    select OPENEMBER_THIRD_PARTY_BUNDLE_YAMLCPP

config OPENEMBER_TP_LINK_ASIO
    bool
    default y if OPENEMBER_USE_ASIO
    select OPENEMBER_THIRD_PARTY_BUNDLE_ASIO

config OPENEMBER_TP_LINK_PAHO
    bool
    default y if OPENEMBER_COMPONENT_MQTT
    select OPENEMBER_THIRD_PARTY_BUNDLE_PAHO

config OPENEMBER_TP_LINK_NNG
    bool
    default y if OPENEMBER_MSGBUS_BACKEND_NNG
    select OPENEMBER_THIRD_PARTY_BUNDLE_NNG

config OPENEMBER_TP_LINK_LCM
    bool
    default y if OPENEMBER_MSGBUS_BACKEND_LCM
    select OPENEMBER_THIRD_PARTY_BUNDLE_LCM

config OPENEMBER_TP_LINK_ZMQ
    bool
    default y if OPENEMBER_MSGBUS_BACKEND_ZMQ
    select OPENEMBER_THIRD_PARTY_BUNDLE_LIBZMQ
    select OPENEMBER_THIRD_PARTY_BUNDLE_CPPZMQ

config OPENEMBER_TP_LINK_RUCKIG
    bool
    default y if OPENEMBER_USE_RUCKIG
    select OPENEMBER_THIRD_PARTY_BUNDLE_RUCKIG

endmenu
```

## tools/Kconfig
```kconfig
menu "Tools"

config OPENEMBER_ENABLE_TOOLS
    bool "Build OpenEmber utilities (tools/)"
    default y
    help
      Host-side command-line utilities shipped with OpenEmber.
      Individual tools may require platform libraries (e.g. LPIO).

config OPENEMBER_ENABLE_TOOLS_EMCOM
    bool "Build emcom (picocom-like serial console)"
    depends on OPENEMBER_ENABLE_TOOLS
    depends on OPENEMBER_ENABLE_LPIO
    default y
    help
      Interactive serial terminal using LPIO SerialPort.
      Installed as executable emcom. Requires OPENEMBER_ENABLE_LPIO.

config OPENEMBER_ENABLE_TOOLS_SBUS_RECEIVER
    bool "Build sbus-receiver (SBUS channel monitor)"
    depends on OPENEMBER_ENABLE_TOOLS
    depends on OPENEMBER_ENABLE_LPIO
    default y
    help
      Receive Futaba SBUS frames and print PWM / switch channels.
      Installed as executable sbus-receiver. Requires OPENEMBER_ENABLE_LPIO.

endmenu
```
