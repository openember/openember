## Kconfig.application
```kconfig
menu "Application"

config OPENEMBER_ENABLE_TESTS
    bool "Build unit tests"
    default y

config OPENEMBER_ENABLE_EXAMPLES
    bool "Build examples"
    default y

menu "Application Nodes"

config OPENEMBER_MODULE_TEMPLATE
    bool "Build app: Template"
    default y

config OPENEMBER_MODULE_ALOGD
    bool "Build app: Alogd"
    default y

config OPENEMBER_MODULE_DEVICE_MANAGER
    bool "Build app: DeviceManager"
    default y

config OPENEMBER_MODULE_MESSAGE_DISPATCHER
    bool "Build app: MessageDispatcher"
    default y

config OPENEMBER_MODULE_CONFIG_MANAGER
    bool "Build app: ConfigManager"
    default y

config OPENEMBER_MODULE_MONITOR_ALARM
    bool "Build app: MonitorAlarm"
    default y

config OPENEMBER_MODULE_OTA
    bool "Build app: OTA"
    default y

config OPENEMBER_MODULE_ACQUISITION
    bool "Build app: Acquisition"
    default y

config OPENEMBER_MODULE_WEB_SERVER
    bool "Build app: WebServer"
    default y

endmenu

endmenu
```

## Kconfig.build
```kconfig
menu "Build Options"

config OPENEMBER_ENABLE_TESTS
    bool "Build unit tests"
    default y

config OPENEMBER_ENABLE_EXAMPLES
    bool "Build examples"
    default y

config OPENEMBER_ENABLE_OPENMP
    bool "Enable OpenMP"
    default n

config OPENEMBER_DEBUG_ENABLED
    bool "Debug build"
    default y

config OPENEMBER_OPTIMIZATION_DISABLED
    bool "Disable optimization"
    default n

config OPENEMBER_CROSSCOMPILE_ENABLED
    bool "Enable cross compile mode (aarch64)"
    default n

endmenu
```

## Kconfig.core
```kconfig
menu "Core"

config OPENEMBER_DEBUG_ENABLED
    bool "Debug build"
    default y

config OPENEMBER_OPTIMIZATION_DISABLED
    bool "Disable optimization"
    default n

config OPENEMBER_ENABLE_OPENMP
    bool "Enable OpenMP"
    default n

endmenu
```

## Kconfig.dependencies
```kconfig
menu "Dependencies"

choice OPENEMBER_THIRD_PARTY_MODE_CHOICE
    prompt "Third-party mode"
    default OPENEMBER_TP_MODE_FETCH

config OPENEMBER_TP_MODE_FETCH
    bool "FetchContent"

config OPENEMBER_TP_MODE_VENDOR
    bool "Vendor (download/_extracted)"

config OPENEMBER_TP_MODE_SYSTEM
    bool "System packages"

endchoice

choice OPENEMBER_JSON_LIBRARY_CHOICE
    prompt "JSON library"
    default OPENEMBER_JSON_LIBRARY_CJSON

config OPENEMBER_JSON_LIBRARY_CJSON
    bool "cJSON (C)"

config OPENEMBER_JSON_LIBRARY_NLOHMANN
    bool "nlohmann/json (C++)"

endchoice

config OPENEMBER_USE_YAMLCPP
    bool "Enable yaml-cpp dependency"
    default y

config OPENEMBER_USE_ASIO
    bool "Enable standalone Asio dependency"
    default y

endmenu
```

## Kconfig.logging
```kconfig
menu "Logging"

choice OPENEMBER_LOG_BACKEND
    prompt "Log backend"
    default OPENEMBER_LOG_BACKEND_ZLOG

config OPENEMBER_LOG_BACKEND_ZLOG
    bool "zlog"

config OPENEMBER_LOG_BACKEND_SPDLOG
    bool "spdlog"

config OPENEMBER_LOG_BACKEND_BUILTIN
    bool "builtin (stderr)"

endchoice

config OPENEMBER_LOG_FILE
    string "zlog.conf path"
    default "/etc/openember/zlog.conf" if OPENEMBER_LOG_BACKEND_ZLOG

endmenu
```

## Kconfig.transport
```kconfig
menu "Transport / Msgbus"

choice OPENEMBER_PUBSUB_BACKEND_CHOICE
    prompt "Pub/Sub backend"
    default OPENEMBER_PUBSUB_BACKEND_ZMQ

config OPENEMBER_PUBSUB_BACKEND_ZMQ
    bool "ZeroMQ"

config OPENEMBER_PUBSUB_BACKEND_NNG
    bool "NNG"

config OPENEMBER_PUBSUB_BACKEND_LCM
    bool "LCM"

endchoice

choice OPENEMBER_MSGBUS_BACKEND_CHOICE
    prompt "Internal msgbus backend"
    default OPENEMBER_MSGBUS_BACKEND_NNG

config OPENEMBER_MSGBUS_BACKEND_NNG
    bool "NNG"

config OPENEMBER_MSGBUS_BACKEND_LCM
    bool "LCM"

endchoice

endmenu
```

## apps/examples/Kconfig
```kconfig
config OPENEMBER_MODULE_TEMPLATE
    bool "Build app: examples/hello_node"
    default y
    depends on OPENEMBER_ENABLE_EXAMPLES

config OPENEMBER_EXAMPLE_MSGBUS_TWO_NODES
    bool "Build example: msgbus_two_nodes (msg_bus publisher/subscriber)"
    default y
    depends on OPENEMBER_ENABLE_EXAMPLES
    help
      Uses the same msg_bus API as framework nodes (NNG or LCM per Kconfig).

config OPENEMBER_EXAMPLE_MSGBUS_NNG_FORWARDER
    bool "Build example: msgbus_nng_forwarder"
    default y
    depends on OPENEMBER_ENABLE_EXAMPLES
    help
      Requires internal msgbus backend NNG; CMake skips otherwise.

config OPENEMBER_EXAMPLE_NETWORK_SOCKETS
    bool "Build example: network_sockets (tcp/udp/unix)"
    default y
    depends on OPENEMBER_ENABLE_EXAMPLES
    help
      Build apps/examples/network_sockets demos for OSAL sockets and Components/Network wrapper.

config OPENEMBER_EXAMPLE_MQTT_EMQX
    bool "Build example: mqtt_emqx_client (Paho C client → EMQX / MQTT broker)"
    default n
    depends on OPENEMBER_ENABLE_EXAMPLES
    depends on OPENEMBER_COMPONENT_MQTT
    help
      Uses openember::mqtt::Client. Configure broker URI, credentials and TLS below.

if OPENEMBER_EXAMPLE_MQTT_EMQX

config OPENEMBER_MQTT_EMQX_HOST
    string "Broker hostname (FQDN, no scheme; e.g. wa366005.ala.cn-hangzhou.emqxsl.cn)"
    default "broker.emqx.io"

choice OPENEMBER_MQTT_EMQX_TRANSPORT
    prompt "Transport (EMQX Cloud: 8883 vs 8084)"
    default OPENEMBER_MQTT_EMQX_TRANSPORT_MQTT_TLS
    help
      MQTT over TLS uses ssl:// on port 8883 by default. WebSocket over TLS uses wss:// on port 8084
      and path /mqtt by default. Use optional full URI below to override.

config OPENEMBER_MQTT_EMQX_TRANSPORT_MQTT_TLS
    bool "MQTT over TLS / SSL (ssl://, default port 8883)"

config OPENEMBER_MQTT_EMQX_TRANSPORT_WSS
    bool "WebSocket over TLS / SSL (wss://, default port 8084)"

endchoice

config OPENEMBER_MQTT_EMQX_PORT
    int "Broker port"
    range 1 65535
    default 8883 if OPENEMBER_MQTT_EMQX_TRANSPORT_MQTT_TLS
    default 8084 if OPENEMBER_MQTT_EMQX_TRANSPORT_WSS

config OPENEMBER_MQTT_EMQX_WSS_PATH
    string "WebSocket path (leading slash; EMQX default /mqtt)"
    depends on OPENEMBER_MQTT_EMQX_TRANSPORT_WSS
    default "/mqtt"

config OPENEMBER_MQTT_EMQX_BROKER_URI
    string "Optional: full broker URI (overrides host/port/transport if non-empty)"
    default ""
    help
      Leave empty to build URI from hostname + port + transport (recommended).
      Set e.g. tcp://host:1883 or a custom wss:// URL for special cases.

config OPENEMBER_MQTT_EMQX_CLIENT_ID
    string "MQTT client id"
    default "openember-mqtt-example"

config OPENEMBER_MQTT_EMQX_USERNAME
    string "MQTT username (optional)"
    default "emqx"

config OPENEMBER_MQTT_EMQX_PASSWORD
    string "MQTT password (optional)"
    default "public"

config OPENEMBER_MQTT_EMQX_TOPIC
    string "Subscribe/publish topic"
    default "emqx/c-test"

config OPENEMBER_MQTT_EMQX_SSL_CAFILE
    string "TLS CA certificate file path"
    default ""
    help
      Download from EMQX console. PEM text is often stored as .crt or .pem — both work if content is PEM.
      The process must be able to read this path (e.g. chmod a+r or run as root). Empty: use system trust
      or disable verify below.

config OPENEMBER_MQTT_EMQX_SSL_VERIFY
    bool "Verify MQTT server TLS certificate"
    default y

endif
```

## apps/references/Kconfig
```kconfig
config OPENEMBER_MODULE_ACQUISITION
    bool "Build app: references/sensor_data_reference"
    default y
```

## apps/services/Kconfig
```kconfig
config OPENEMBER_MODULE_OTA
    bool "Build app: services/ota_update_service"
    default y

config OPENEMBER_MODULE_WEB_SERVER
    bool "Build app: services/web_dashboard"
    default y

config OPENEMBER_WEB_DASHBOARD_ROOT_DIR
    string "web_dashboard web root directory"
    default "apps/services/web_dashboard/web_root"
    depends on OPENEMBER_MODULE_WEB_SERVER
    help
      Default web root directory for web_dashboard.
      If a relative path is used, CMake will treat it as relative to the repository root.

config OPENEMBER_WEB_DASHBOARD_PORT
    int "web_dashboard HTTP port"
    default 8000
    range 1 65535
    depends on OPENEMBER_MODULE_WEB_SERVER
    help
      HTTP listen port for web_dashboard. Server binds to 0.0.0.0:<port>.

config OPENEMBER_MODULE_LOGGER
    bool "Build app: services/logger"
    default y

config OPENEMBER_LOGGER_PORT
    int "logger HTTP port (local)"
    default 18081
    range 1 65535
    depends on OPENEMBER_MODULE_LOGGER
    help
      Local listen port for logger service, typically bound to 127.0.0.1.

config OPENEMBER_LOGGER_LOG_DIR
    string "logger source log directory"
    default "/var/log/openember"
    depends on OPENEMBER_MODULE_LOGGER
    help
      Directory where logger scans *.log files generated by process log sinks.
```

## apps/system/Kconfig
```kconfig
config OPENEMBER_MODULE_LAUNCH_MANAGER
    bool "Build app: system/launch_manager"
    default y

config OPENEMBER_MODULE_ALOGD
    bool "Build app: system/log_service"
    default y

config OPENEMBER_MODULE_DEVICE_MANAGER
    bool "Build app: system/device_manager"
    default y

config OPENEMBER_MODULE_CONFIG_MANAGER
    bool "Build app: system/config_service"
    default y

config OPENEMBER_MODULE_MONITOR_ALARM
    bool "Build app: system/health_monitor"
    default y
```

## components/Kconfig
```kconfig
menu "Component"

menu "Logging"

choice OPENEMBER_LOG_BACKEND
    prompt "Log backend"
    default OPENEMBER_LOG_BACKEND_SPDLOG

config OPENEMBER_LOG_BACKEND_ZLOG
    bool "zlog"

config OPENEMBER_LOG_BACKEND_SPDLOG
    bool "spdlog"

config OPENEMBER_LOG_BACKEND_BUILTIN
    bool "builtin (stderr)"

endchoice

config OPENEMBER_LOG_FILE
    string "zlog.conf path"
    depends on OPENEMBER_LOG_BACKEND_ZLOG
    default "/etc/openember/zlog.conf" if OPENEMBER_LOG_BACKEND_ZLOG

choice OPENEMBER_SPDLOG_LEVEL_CHOICE
    prompt "spdlog: log level"
    depends on OPENEMBER_LOG_BACKEND_SPDLOG
    default OPENEMBER_SPDLOG_LEVEL_INFO

config OPENEMBER_SPDLOG_LEVEL_DEBUG
    bool "debug"

config OPENEMBER_SPDLOG_LEVEL_INFO
    bool "info"

config OPENEMBER_SPDLOG_LEVEL_WARN
    bool "warn"

config OPENEMBER_SPDLOG_LEVEL_ERROR
    bool "error"

endchoice

choice OPENEMBER_SPDLOG_FLUSH_LEVEL_CHOICE
    prompt "spdlog: flush on level"
    depends on OPENEMBER_LOG_BACKEND_SPDLOG
    default OPENEMBER_SPDLOG_FLUSH_INFO

config OPENEMBER_SPDLOG_FLUSH_INFO
    bool "info"

config OPENEMBER_SPDLOG_FLUSH_WARN
    bool "warn"

config OPENEMBER_SPDLOG_FLUSH_ERROR
    bool "error"

endchoice

config OPENEMBER_SPDLOG_PATTERN
    string "spdlog: pattern"
    depends on OPENEMBER_LOG_BACKEND_SPDLOG
    default "[%Y-%m-%d %H:%M:%S.%e] [%^%l%$] %v"

config OPENEMBER_SPDLOG_ENABLE_STDOUT
    bool "spdlog: enable stdout sink"
    depends on OPENEMBER_LOG_BACKEND_SPDLOG
    default y

config OPENEMBER_SPDLOG_ENABLE_FILE
    bool "spdlog: enable file sink (rotating)"
    depends on OPENEMBER_LOG_BACKEND_SPDLOG
    default y

config OPENEMBER_SPDLOG_FILE_DIR
    string "spdlog: file directory"
    depends on OPENEMBER_SPDLOG_ENABLE_FILE
    default "/var/log/openember"

config OPENEMBER_SPDLOG_ROTATE_MAX_MB
    int "spdlog: rotate max size (MiB)"
    depends on OPENEMBER_SPDLOG_ENABLE_FILE
    default 10
    range 1 1024

config OPENEMBER_SPDLOG_ROTATE_MAX_FILES
    int "spdlog: rotate max files"
    depends on OPENEMBER_SPDLOG_ENABLE_FILE
    default 5
    range 1 100

config OPENEMBER_SPDLOG_ENABLE_SYSLOG
    bool "spdlog: enable syslog sink (journald can collect)"
    depends on OPENEMBER_LOG_BACKEND_SPDLOG
    default n

config OPENEMBER_SPDLOG_ENABLE_TOPIC
    bool "spdlog: enable topic sink (/openember/log)"
    depends on OPENEMBER_LOG_BACKEND_SPDLOG
    default y
    help
      Publish log entries to pub/sub topic so other nodes (web_dashboard/loggerd) can subscribe.

config OPENEMBER_SPDLOG_TOPIC_NAME
    string "spdlog: topic name"
    depends on OPENEMBER_SPDLOG_ENABLE_TOPIC
    default "/openember/log"
    help
      Pub/sub topic name for log stream.

config OPENEMBER_SPDLOG_TOPIC_PUB_URL
    string "spdlog: topic transport (msg_bus bind / LCM provider)"
    depends on OPENEMBER_SPDLOG_ENABLE_TOPIC
    default "udpm://239.255.76.67:7667?ttl=1" if OPENEMBER_MSGBUS_BACKEND_LCM
    default "tcp://*:7561"
    help
      Passed to msg_bus / TransportBackend init (must match selected msgbus backend).
      LCM: udpm://... ; NNG: tcp://*:7561 (example).

config OPENEMBER_SPDLOG_TOPIC_SUB_URL
    string "spdlog: topic hint (documentation; subscriber uses same msgbus as process)"
    depends on OPENEMBER_SPDLOG_ENABLE_TOPIC
    default "udpm://239.255.76.67:7667?ttl=1" if OPENEMBER_MSGBUS_BACKEND_LCM
    default "tcp://127.0.0.1:7561"
    help
      Reserved for diagnostics; log subscribers use msg_bus on the node default transport.

choice OPENEMBER_SPDLOG_TOPIC_LEVEL_CHOICE
    prompt "spdlog: topic publish level threshold"
    depends on OPENEMBER_SPDLOG_ENABLE_TOPIC
    default OPENEMBER_SPDLOG_TOPIC_LEVEL_INFO

config OPENEMBER_SPDLOG_TOPIC_LEVEL_DEBUG
    bool "debug"

config OPENEMBER_SPDLOG_TOPIC_LEVEL_INFO
    bool "info"

config OPENEMBER_SPDLOG_TOPIC_LEVEL_WARN
    bool "warn"

config OPENEMBER_SPDLOG_TOPIC_LEVEL_ERROR
    bool "error"

endchoice

config OPENEMBER_SPDLOG_TOPIC_RATE_LIMIT
    int "spdlog: topic rate limit (lines/sec, 0=unlimited)"
    depends on OPENEMBER_SPDLOG_ENABLE_TOPIC
    default 0
    range 0 1000000
    help
      Rate limit for topic publishing to protect bus bandwidth. 0 means unlimited.

endmenu

menu "Serialization / Config"

choice OPENEMBER_JSON_LIBRARY_CHOICE
    prompt "JSON library"
    default OPENEMBER_JSON_LIBRARY_CJSON

config OPENEMBER_JSON_LIBRARY_CJSON
    bool "cJSON (C)"

config OPENEMBER_JSON_LIBRARY_NLOHMANN
    bool "nlohmann/json (C++)"

endchoice

config OPENEMBER_USE_YAMLCPP
    bool "Enable yaml-cpp dependency"
    default y

endmenu

menu "Networking Utility"

config OPENEMBER_USE_ASIO
    bool "Enable standalone Asio dependency"
    default y

endmenu

menu "Motion / trajectory"

config OPENEMBER_USE_RUCKIG
    bool "Enable ruckig (jerk-limited trajectory; C++20)"
    default n
    help
      Optional MIT library for online motion generation. When enabled, CMake fetches or uses
      OPENEMBER_RUCKIG_LOCAL_SOURCE; link targets with ruckig::ruckig.

endmenu

menu "Network"

config OPENEMBER_COMPONENT_NETWORK
    bool "Build component: Network (high-level socket wrapper)"
    default y
    depends on OPENEMBER_ENABLE_OSAL
    help
      Build Components/Network library (URI-based high-level socket wrapper) on top of OSAL sockets.

endmenu

menu "MQTT (Eclipse Paho C)"

config OPENEMBER_COMPONENT_MQTT
    bool "Build component: MQTT client (Paho MQTT C + openember_mqtt)"
    default y
    help
      Fetches/builds Eclipse paho.mqtt.c and links it into the framework. Application-level broker
      URI and credentials belong in Application → examples (mqtt_emqx_client), not here.

config OPENEMBER_MQTT_PAHO_TLS
    bool "Build Paho with OpenSSL (TLS / ssl://)"
    default y
    depends on OPENEMBER_COMPONENT_MQTT
    help
      When enabled, CMake requires OpenSSL development packages (e.g. libssl-dev) so Paho is built
      as paho-mqtt3cs and ssl:// URIs work. Disable only for plain tcp:// brokers without TLS.

config OPENEMBER_MQTT_PAHO_ASYNC
    bool "Link Paho MQTTAsync (async API) in addition to MQTTClient"
    default n
    depends on OPENEMBER_COMPONENT_MQTT
    help
      openember::mqtt::Client uses only the synchronous MQTTClient API. Leave disabled to link only
      paho-mqtt3c(s) and reduce binary size. Enable if you call MQTTAsync elsewhere or need both libs.

endmenu

endmenu
```
